## sdkconfig.defaults
```kconfig
CONFIG_DEBUG_PROBE_IFACE_SWD=y
CONFIG_HTTPD_WS_SUPPORT=y
CONFIG_FREERTOS_HZ=1000
CONFIG_ESP32S3_DEFAULT_CPU_FREQ_240=y
CONFIG_FATFS_MAX_LFN=255
CONFIG_CXX_EXCEPTIONS=y
CONFIG_GPIO_CTRL_FUNC_IN_IRAM=y
CONFIG_COMPILER_CXX_EXCEPTIONS_EMG_POOL_SIZE=1024
CONFIG_FATFS_LFN_NONE=n
CONFIG_HTTPD_MAX_REQ_HDR_LEN=1024
CONFIG_FATFS_LFN_HEAP=y

CONFIG_TINYUSB_DESC_MANUFACTURER_STRING="hongquan.prog@gmail.com"
CONFIG_TINYUSB_DESC_PRODUCT_STRING="ESP32 CMSIS-DAP"
CONFIG_TINYUSB_DESC_SERIAL_STRING="456477898416132156"
CONFIG_TINYUSB_DESC_CDC_STRING="CMSIS-DAP CDC"
CONFIG_TINYUSB_DESC_MSC_STRING="Espressif MSC Device"
```
