## components/USBIP/Kconfig
```kconfig
menu "USBIP Configuration"

config USBIP_ENABLE_WINUSB
    bool "Enable WinUSB mode"
    default y
    help
        Enable WinUSB mode for DAPLink.
        WinUSB mode provides better performance with 512-byte packet size.
        Disable this for HID mode, which is required for Keil MDK compatibility.

choice USBIP_USB_SPEED
    prompt "USB Speed"
    default USBIP_USB_SPEED_2_0
    help
        Select USB speed mode.
        USB 2.0 uses 512-byte endpoint size.
        USB 3.0 uses 1024-byte endpoint size.

    config USBIP_USB_SPEED_2_0
        bool "USB 2.0"

    config USBIP_USB_SPEED_3_0
        bool "USB 3.0"
endchoice

config USBIP_ENABLE_USB_3_0
    bool
    default y if USBIP_USB_SPEED_3_0
    default n if USBIP_USB_SPEED_2_0

config USBIP_ENDPOINT_SIZE
    int
    default 1024 if USBIP_ENABLE_USB_3_0
    default 512 if !USBIP_ENABLE_USB_3_0

endmenu
```

## components/debug_probe/Kconfig
```kconfig
menu "Debug Probe Configuration"

    choice DEBUG_PROBE_INTERFACE
        prompt "Debug interface"
        default DEBUG_PROBE_IFACE_JTAG
        help
            Select which debug interface to use

        config DEBUG_PROBE_IFACE_JTAG
            bool "ESP-USB JTAG"
        config DEBUG_PROBE_IFACE_SWD
            bool "CMSIS-DAP SWD"
    endchoice

    choice DEBUG_PROBE_GPIO_MODE
        prompt "GPIO driver mode"
        default DEBUG_PROBE_USE_DEDICATED_GPIO
        help
            Select GPIO driver mode. Dedicated GPIO provides higher
            performance for JTAG/SWD operations but is only available
            on ESP32-S3 and similar chips.

        config DEBUG_PROBE_USE_DEDICATED_GPIO
            bool "Dedicated GPIO (high speed)"
        config DEBUG_PROBE_USE_REGULAR_GPIO
            bool "Regular GPIO (broad compatibility)"
    endchoice

    config DEBUG_PROBE_IFACE_NAME
        string
        default "JTAG" if DEBUG_PROBE_IFACE_JTAG
        default "CMSIS-DAP"

    config DEBUG_PROBE_GPIO_TDI
        int "GPIO pin for the target TDI signal"
        default 3
        help
            GPIO pin connected to target's TDI (Test Data Input) signal

    config DEBUG_PROBE_GPIO_TDO
        int "GPIO pin for the target TDO signal"
        default 9
        help
            GPIO pin connected to target's TDO (Test Data Output) signal

    config DEBUG_PROBE_GPIO_TCK
        int "GPIO pin for the target TCK signal"
        default 10
        help
            GPIO pin connected to target's TCK (Test Clock) signal

    config DEBUG_PROBE_GPIO_TMS
        int "GPIO pin for the target TMS signal"
        default 8
        help
            GPIO pin connected to target's TMS (Test Mode Select) signal

    config DEBUG_PROBE_SWJ_CLOCK
        int "Default SWJ Clock"
        range 500000 10000000
        default 4000000

endmenu
```

## components/usbipd/Kconfig
```kconfig
# USBIP Server Kconfig Configuration
#
menu "USBIP Server Configuration"

config USBIP_SERVER_ENABLED
    bool "Enable USBIP Server"
    default y
    help
        Enable USBIP server for wireless debugging.

config USBIP_SERVER_PORT
    int "Server listen port"
    default 3240
    depends on USBIP_SERVER_ENABLED
    help
        The TCP port for the USBIP server to listen on.
        Default is 3240 (standard USBIP port).

config URB_THREAD_STACK_SIZE
    int "USBIP server task stack size"
    default 4096
    depends on USBIP_SERVER_ENABLED
    help
        Stack size for the USBIP server task.

config URB_THREAD_PRIORITY
    int "USBIP server task priority"
    default 14
    depends on USBIP_SERVER_ENABLED
    help
        Priority for the USBIP server task.

config USBIP_URB_QUEUE_SIZE
    int "URB queue slots per connection"
    default 2
    range 4 64
    help
        Number of URB slots in the per-connection queue.

        Each connection has its own URB queue for buffering requests
        between the RX thread and the processor thread.

        Larger values improve throughput but consume more memory.
        For high-latency networks, increase this value.

        Memory impact: sizeof(urb_slot) * USBIP_URB_QUEUE_SIZE per connection

config USBIP_URB_DATA_MAX_SIZE
    int "Maximum URB data size (bytes)"
    default 512
    range 64 4096
    help
        Maximum data size per URB transfer.

        This value must be large enough to accommodate the largest
        endpoint buffer size of any attached USB device.

        Typical values:
        - HID devices (CMSIS-DAP v1): 64 bytes
        - Bulk devices (CMSIS-DAP v2): 512 bytes
        - High-speed bulk endpoints: 512-1024 bytes

        Note: Each URB slot allocates a buffer of this size,
        so larger values significantly increase memory usage.

        Memory impact: USBIP_URB_DATA_MAX_SIZE * USBIP_URB_QUEUE_SIZE per connection

config USBIP_MAX_CONNECTIONS
    int "Maximum simultaneous device connections"
    default 2
    range 1 16
    help
        Maximum number of USB devices that can be exported simultaneously.

        Each connection spawns two threads (RX and Processor) and
        allocates a URB queue. Increasing this value allows more
        clients to connect but consumes more system resources.

        For single-device setups (e.g., one DAP), 1-2 is sufficient.
        For multi-probe setups, increase as needed.

config USBIP_MAX_DRIVERS
    int "Maximum registered device drivers"
    default 4
    range 1 16
    help
        Maximum number of device drivers that can be registered.

        Each registered driver consumes one pointer slot in the
        internal driver registry. For typical setups with 1-2
        drivers (e.g., HID DAP and Bulk DAP), the default of 4
        is sufficient.

config USBIP_LOG_LEVEL
    int "USBIP log level"
    range 0 4
    default 3
    depends on USBIP_SERVER_ENABLED
    help
        Set the log level for USBIP server.
        0 = None
        1 = Error
        2 = Warning
        3 = Info
        4 = Debug

config DAP_LOG_LEVEL
    int "DAPLink log level"
    default 3
    range 0 4

endmenu
```

## components/util/Kconfig
```kconfig
menu "Util Configuration"

    config BRIDGE_GPIO_LED1
        int "GPIO pin LED1"
        default 12
        help
            GPIO pin for LED1 (typically TX activity indicator)

    config BRIDGE_GPIO_LED2
        int "GPIO pin LED2"
        default 13
        help
            GPIO pin for LED2 (typically RX activity indicator)

    config BRIDGE_GPIO_LED1_ACTIVE
        int "GPIO pin LED1 active value"
        range 0 1
        default 0
        help
            Logic level when LED1 is active (0=active low, 1=active high)

    config BRIDGE_GPIO_LED2_ACTIVE
        int "GPIO pin LED2 active value"
        range 0 1
        default 0
        help
            Logic level when LED2 is active (0=active low, 1=active high)

endmenu
```

## main/Kconfig.projbuild
```kconfig
menu "ESP32 DAPLink Configuration"

config USB_DEBUG_PROBE
    bool "Enable USB debug probe"
    default n
    help
        Enable USB debug probe functionality (CMSIS-DAP via TinyUSB).

config TINYUSB_DESC_HID_STRING
    string "HID Device Name"
    default "ESP32 HID CMSIS-DAP"
    depends on USB_DEBUG_PROBE
    help
        HID device name

config TINYUSB_DESC_VENDOR_STRING
    string "Vendor Bulk Device Name"
    default "ESP32 Bulk CMSIS-DAP"
    depends on USB_DEBUG_PROBE

config WEBUSB_URL
    string "WebUSB URL"
    default "example.tinyusb.org/webusb-serial/index.html"
    depends on USB_DEBUG_PROBE

choice MSC_STORAGE_MEDIA
    prompt "Storage Media Used"
    default MSC_STORAGE_MEDIA_SPIFLASH
    help
        Select the storage media that is exposed to USB host.

    config MSC_STORAGE_MEDIA_SPIFLASH
        bool "SPI FLASH"

    config MSC_STORAGE_MEDIA_SDMMCCARD
        bool "SDMMC CARD"
        depends on IDF_TARGET_ESP32S3
        depends on TINYUSB_MSC_ENABLED
endchoice

choice DAPLINK_CONNECT_METHOD
    prompt "DAPLink connection method"
    default BULK_DAPLINK
    depends on USB_DEBUG_PROBE
    config HID_DAPLINK
        bool "Connect to computer by HID"

    config BULK_DAPLINK
        bool "Connect to computer by bulk transmission"
        select TINYUSB_VENDOR_ENABLED
endchoice

config DAPLINK_DESC_STRING
    string
    default TINYUSB_DESC_HID_STRING if HID_DAPLINK
    default TINYUSB_DESC_VENDOR_STRING if BULK_DAPLINK
    depends on USB_DEBUG_PROBE

config HTTPD_MAX_OPENED_SOCKETS
    int "The max opened sockets of http server"
    default 5

config HTTPD_RESP_BUF_SIZE
    int "The size of http server to replay"
    default 512

config PROGRAMMER_ALGORITHM_ROOT
    string "The folder where the algorithms are stored"
    default "/data/algorithm"

config PROGRAMMER_PROGRAM_ROOT
    string "The folder where the programs are stored"
    default "/data/program"

config PROGRAMMER_FILE_MAX_LEN
    int "Maximum length of file path"
    default 128

endmenu
```

## sdkconfig.defaults.esp32
```kconfig
CONFIG_DEBUG_PROBE_USE_REGULAR_GPIO=y
CONFIG_PARTITION_TABLE_CUSTOM=y
CONFIG_PARTITION_TABLE_CUSTOM_FILENAME="partitions-4m.csv"
CONFIG_PARTITION_TABLE_FILENAME="partitions-4m.csv"
CONFIG_ESPTOOLPY_FLASHSIZE_4MB=y

CONFIG_USB_DEBUG_PROBE=n
CONFIG_DEBUG_PROBE_GPIO_TDI=3
CONFIG_DEBUG_PROBE_GPIO_TDO=10
CONFIG_DEBUG_PROBE_GPIO_TCK=9
CONFIG_DEBUG_PROBE_GPIO_TMS=8

CONFIG_BRIDGE_GPIO_LED1=17
CONFIG_BRIDGE_GPIO_LED2=18
CONFIG_BRIDGE_GPIO_LED1_ACTIVE=1
CONFIG_BRIDGE_GPIO_LED2_ACTIVE=1
```

## sdkconfig.defaults.esp32s3
```kconfig
CONFIG_DEBUG_PROBE_USE_DEDICATED_GPIO=y
CONFIG_PARTITION_TABLE_CUSTOM=y
CONFIG_PARTITION_TABLE_CUSTOM_FILENAME="partitions-16m.csv"
CONFIG_PARTITION_TABLE_FILENAME="partitions-16m.csv"
CONFIG_ESPTOOLPY_FLASHSIZE_16MB=y

CONFIG_USB_DEBUG_PROBE=y
CONFIG_HID_DAPLINK=y
CONFIG_TINYUSB_HID_COUNT=1
CONFIG_TINYUSB_VENDOR_COUNT=1
CONFIG_TINYUSB_DESC_MANUFACTURER_STRING="hongquan.prog@gmail.com"
CONFIG_TINYUSB_DESC_PRODUCT_STRING="ESP32 CMSIS-DAP"
CONFIG_TINYUSB_DESC_SERIAL_STRING="456477898416132156"
CONFIG_TINYUSB_DESC_CDC_STRING="CMSIS-DAP CDC"
CONFIG_TINYUSB_DESC_MSC_STRING="Espressif MSC Device"
CONFIG_TINYUSB_CDC_ENABLED=y
CONFIG_TINYUSB_CDC_COUNT=1
CONFIG_TINYUSB_CDC_RX_BUFSIZE=64
CONFIG_TINYUSB_CDC_TX_BUFSIZE=64
CONFIG_TINYUSB_MSC_ENABLED=y
CONFIG_TINYUSB_MSC_BUFSIZE=4096
CONFIG_TINYUSB_MSC_MOUNT_PATH="/data"
CONFIG_TINYUSB_DESC_USE_ESPRESSIF_VID=n
CONFIG_TINYUSB_DESC_USE_DEFAULT_PID=n
CONFIG_TINYUSB_DESC_CUSTOM_VID=0x0d28
CONFIG_TINYUSB_DESC_CUSTOM_PID=0x0204

CONFIG_BRIDGE_GPIO_LED1=17
CONFIG_BRIDGE_GPIO_LED2=18
CONFIG_BRIDGE_GPIO_LED1_ACTIVE=1
CONFIG_BRIDGE_GPIO_LED2_ACTIVE=1

CONFIG_DEBUG_PROBE_GPIO_TDI=3
CONFIG_DEBUG_PROBE_GPIO_TDO=10
CONFIG_DEBUG_PROBE_GPIO_TCK=9
CONFIG_DEBUG_PROBE_GPIO_TMS=8

CONFIG_FREERTOS_UNICORE=y
```
